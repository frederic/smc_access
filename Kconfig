## Kconfig
```kconfig
# Amlogic DEBUG
#
config AML_SMC_ACCESS
    bool "Amlogic SMC call from userspace support"
    default m
    help
      This is the Amlogic debug sysfs interface driver using debugfs interface
```
